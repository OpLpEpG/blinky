## Kconfig
```kconfig
# General configuration options

# Copyright (c) 2014-2015 Wind River Systems, Inc.
# SPDX-License-Identifier: Apache-2.0

mainmenu "Zephyr Kernel Configuration + Umdom"

#comment "Umdom Zephyr modules config"
menu "Umdom Zephyr: modules"
source "${ZEPHYR_UMDOM}/Kconfig"
endmenu

menu "Umdom project: modules"
orsource "modules/Kconfig.*"
endmenu

comment "Zephyr Kernel Configuration"
source "$(ZEPHYR_BASE)/Kconfig.zephyr"
```

## modules/Kconfig.am2320
```kconfig
# General configuration options

# Copyright (c) 2014-2015 Wind River Systems, Inc.
# SPDX-License-Identifier: Apache-2.0

config DEV_AM2320
    bool "am2320"
```

## modules/Kconfig.modbus
```kconfig
# General configuration options

# Copyright (c) 2014-2015 Wind River Systems, Inc.
# SPDX-License-Identifier: Apache-2.0

config DEV_MODBUS
    bool "modbus"
    default y
    depends on LIGHTMODBUS_SLAVE_BASE && UART3_DMA

if DEV_MODBUS 

config DEV_MODBUS_TXE_GPIO_PORT
    string "port TXE modbus"
    default GPIOC
    help
    CPIOA, CPIOB, CPIOC, CPIOD

config DEV_MODBUS_TXE_GPIO_PIN
    int "port pin TXE modbus 0..15"
    default 13
    help
    0..15
endif
```
